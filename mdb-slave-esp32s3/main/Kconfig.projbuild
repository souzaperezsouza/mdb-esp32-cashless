## mdb-slave-esp32s3/main/Kconfig.projbuild
```kconfig
menu "VMflow"

menu "MDB Cashless Device"

    choice
        prompt "Peripheral Addresses"
        default CASHLESS_ADDR_1

        config CASHLESS_ADDR_1
            bool "Cashless Device #1"

        config CASHLESS_ADDR_2
            bool "Cashless Device #2"

    endchoice

    config CASHLESS_DEVICE_ADDRESS
        int
        default 16 if CASHLESS_ADDR_1
        default 96 if CASHLESS_ADDR_2

    choice
        prompt "Country / Currency Code"
        default CURRENCY_BRL

        config CURRENCY_EUR
            bool "EUR - 0x0978"

        config CURRENCY_USD
            bool "USD - 0x0840"

        config CURRENCY_BRL
            bool "BRL - 0x0986"

        config CURRENCY_UNKNOWN
            bool "UNKNOWN - 0xffff"
    endchoice

    config MDB_CURRENCY_CODE
        int
        default 6520 if CURRENCY_EUR
        default 6208 if CURRENCY_USD
        default 6534 if CURRENCY_BRL
        default 65535 if CURRENCY_UNKNOWN

    choice
        prompt "Scale Factor (MDB)"
        default SCALE_FACTOR_1

        config SCALE_FACTOR_1
            bool "1"

        config SCALE_FACTOR_10
            bool "10"

        config SCALE_FACTOR_100
            bool "100"

    endchoice

    config MDB_SCALE_FACTOR
        int
        default 1 if SCALE_FACTOR_1
        default 10 if SCALE_FACTOR_10
        default 100 if SCALE_FACTOR_100

    config MDB_DECIMAL_PLACES
        int "Decimal Places (MDB)"
        default 2
        range 0 3

    config ALWAYS_OPEN_SESSION
        bool "Keep a session with unknown funds always open"
        default y
        help
            When the machine enables the reader, and again after every session
            ends, open a session with funds 0xFFFF (same as the BLE 0x02
            command). The machine then accepts a selection at any time and each
            VEND_REQUEST waits for an approve/deny from the server. The 60 s idle
            timeout does not apply to this session. The "credit" RPC has no
            effect while this is enabled.

endmenu # MDB Cashless Device

menu "MQTT Server"

    config MQTT_BROKER_URI
        string "Broker URI"
        default "wss://seu-broker.onrender.com:443/mqtt"
        help
            mqtt://, mqtts://, ws:// or wss://. The TLS schemes (mqtts, wss)
            verify the server certificate against the ESP-IDF certificate bundle.

    config MQTT_USERNAME
        string "Username (empty = device subdomain)"
        default ""

    config MQTT_PASSWORD
        string "Password"
        default ""

    config MQTT_TOPIC_PREFIX
        string "Outbound topic prefix"
        default "maquinas"
        help
            The device publishes on <prefix>/<subdomain>/<event>
            (sale, vend_fail, status, rpc/confirm, ...).

    config MQTT_RPC_PREFIX
        string "Inbound (RPC) topic prefix"
        default "cmd"
        help
            The device subscribes to <prefix>/<subdomain>/# and runs the
            signed commands published on <prefix>/<subdomain>/rpc.

    config EVENT_QUEUE_MAX
        int "Max sales events kept in flash until the broker acknowledges them"
        default 32
        range 8 64
        help
            sale, vend_request, vend_success and vend_fail are stored in NVS and
            removed only after the QoS 1 PUBACK. When full, the oldest is dropped
            (counted in rpc/info as events_dropped). Each event takes ~5 NVS
            entries; the default 24 KB NVS partition holds about 600.

endmenu # MQTT Server

menu "SIM7080G"

    choice
        prompt "LTE Network Mode"
        default SIM7080G_CMNB_BOTH

        config SIM7080G_CMNB_CATM
            bool "Cat-M only"

        config SIM7080G_CMNB_NBIOT
            bool "NB-IoT only"

        config SIM7080G_CMNB_BOTH
            bool "Both (LTE-M + NB-IoT)"

    endchoice

    config SIM7080G_CMNB
        int
        default 1 if SIM7080G_CMNB_CATM
        default 2 if SIM7080G_CMNB_NBIOT
        default 3 if SIM7080G_CMNB_BOTH

    config SIM7080G_APN
        string "APN"
        default "lf.br"

endmenu # SIM7080G

endmenu # VMflow
```
